## package/conmon/Config.in
```kconfig
config BR2_PACKAGE_CONMON
  bool conmon
  depends on BR2_USE_WCHAR # glib2
  depends on BR2_TOOLCHAIN_HAS_THREADS # glib2
  depends on BR2_USE_MMU # glib2
  depends on BR2_PACKAGE_HOST_GO_TARGET_ARCH_SUPPORTS 
  depends on BR2_PACKAGE_HOST_GO_TARGET_CGO_LINKING_SUPPORTS
  select BR2_PACKAGE_LIBGLIB2
  select BR2_PACKAGE_LIBSECCOMP
  help
    conmon is a monitoring and communication tool between containers
    and a container runtime. conmon is regularly used as an
    interface between runc/crun and podman/CRI-O.
    
```

## package/podman/Config.in
```kconfig
config BR2_PACKAGE_PODMAN
  bool "podman"
  depends on BR2_PACKAGE_HOST_GO_TARGET_ARCH_SUPPORTS 
  depends on BR2_PACKAGE_HOST_GO_TARGET_CGO_LINKING_SUPPORTS
  select BR2_PACKAGE_BRIDGE_UTILS # Required for container networking
  select BR2_PACKAGE_IPTABLES # Required for container network
  select BR2_PACKAGE_CRUN # runtime dependency
  select BR2_PACKAGE_CONMON  # runtime dependency
  select BR2_PACKAGE_CNI_PLUGINS # runtime dependency
  select BR2_PACKAGE_CGROUPFS_MOUNT if !BR2_PACKAGE_SYSTEMD # runtime dependency
  select BR2_PACKAGE_CA_CERTIFICATES # Required for the podman pull command via https
  select BR2_PACKAGE_SLIRP4NETNS # Required for rootless network access
  select BR2_PACKAGE_SHADOW # Required for rootless support
  select BR2_PACKAGE_SHADOW_SUBORDINATE_IDS # Required for rootless support
  help
    The podman container runtime and manager.

if BR2_PACKAGE_PODMAN

config BR2_PACKAGE_PODMAN_SELINUX
  bool "selinux support"
  select BR2_PACKAGE_LIBSELINUX
  help
    Compiles podman with the selinux BUILDTAG

config BR2_PACKAGE_PODMAN_SYSTEMD
  bool "journald logging support"
  select BR2_PACKAGE_SYSTEMD
  help
    Compiles podman with the systemd BUILDTAG.

config BR2_PACKAGE_PODMAN_SECCOMP
  bool "syscall filtering via seccomp"
  depends on BR2_PACKAGE_LIBSECCOMP_ARCH_SUPPORTS
  select BR2_PACKAGE_LIBSECCOMP
  help
    Compiles podman with the seccomp BUILDTAG enabling seccomp based syscall filtering support.

config BR2_PACKAGE_PODMAN_BTFRS
  bool "btrfs filesystem driver"
  select BR2_PACKAGE_BTRFS_PROGS 
  depends on BR2_USE_MMU # btrfs-progs
  depends on BR2_TOOLCHAIN_HAS_THREADS # btrfs-progs
  help
    Build the btrfs filesystem driver for Podman.

config BR2_PACKAGE_PODMAN_DEVICEMAPPER
  bool "devicemapper filesystem driver"
  depends on BR2_TOOLCHAIN_HAS_THREADS # lvm2
  depends on BR2_USE_MMU # lvm2
  depends on !BR2_STATIC_LIBS # lvm2
  select BR2_PACKAGE_LVM2
  help
    Build the devicemapper filesystem driver for Docker.

endif
```
